## drivers/input/fingerprint/Kconfig
```kconfig
#
#Fingerprint
#
menu "Fingerprint support"
	depends on INPUT

config MTK_FINGERPRINT_SUPPORT
	bool "Mediatek Fingerprint"
	default n
	---help---
	Fingerprint mtk driver enable/disable in the kernel.
	Say Y here if you want to use mediatek fingerprint driver,
	fingerprint driver will support fingerprint function in REE,
	it supports FPC's 102x/104x device.

if MTK_FINGERPRINT_SUPPORT
config MTK_FINGERPRINT_SELECT
	string "sensor type"
	default "GF318M"

# Fingerprint sensor
if MTK_FINGERPRINT_SELECT = "ET310"
config MTK_ET310
        bool "ET310 for MediaTek package"
        default n
endif

config MTK_AFS12X
        bool "AFS12X for MediaTek package"
        default n

config NB_FINGER_CLEAR_SUPPORT
        bool "NB FINGER CLEAR SUPPORT"
        default n
        
if MTK_FINGERPRINT_SELECT = "FPC1145"
config FPC_FINGERPRINT
	bool "FPC Fingerprint"
	default y
	---help---
	FPC fingerprint FPC's 102x/104x device.
endif

if MTK_FINGERPRINT_SELECT = "GF318M"
config GOODIX_FINGERPRINT
	bool "Goodix Fingerprint"
	default y
	---help---
	Goodix Fingerprint chip GF516/GF318GF316M/GF616M/GF318M TEE driver

endif
endif
endmenu
```

## drivers/misc/mediatek/accelerometer/lsm6ds0/Kconfig
```kconfig
config MTK_LSM6DS0A
        bool "LSM6DS0A for MediaTek package"
        default n
	help
	  It support different accelerometer sensor.
          If this option is set,
	  it will support
          LSM6DS0A Accelerometer.
```

## drivers/misc/mediatek/alsps/ap3xx6/Kconfig
```kconfig
config MTK_AP3XX6
	bool "AP3XX6 for MediaTek package"
	default n
	help
	It support different type sensor
	in this platform. If this option
	is set, it will support ambient
	and light sensor AP3XX6.
```

## drivers/misc/mediatek/cache_dump/Kconfig
```kconfig
config MTK_CACHE_DUMP
  bool "enable CONFIG_MTK_CACHE_DUMP"
  default y
  help
    Enable cache dump feature
```

## drivers/misc/mediatek/gyroscope/lsm6ds0gy/Kconfig
```kconfig
config MTK_LSM6DS0G
        bool "LSM6DS0G for MediaTek package"
        default n
	help
        It support different gyroscope sensor.
        If this option is set,
	  	it will support
         LSM6DS0G gyroscope.
```

## drivers/misc/mediatek/magnetometer/mmc3416x/Kconfig
```kconfig
config MTK_MMC3416X
	bool "MMC3416X for MediaTek package"
	default n
	help
	  It support different magnetometer sensor.
          If this option is set,
	  it will support
          MMC3416X magnetometer.
```

## drivers/misc/mediatek/rt-regmap/Kconfig
```kconfig
config RT_REGMAP
	bool "Richtek Regmap"
	depends on ARCH_MT6797
	select DEBUG_FS
	default y
	help
	  Say Y to enable Richtek Register Map
```
