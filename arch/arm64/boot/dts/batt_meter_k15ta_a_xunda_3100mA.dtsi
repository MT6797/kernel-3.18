&bat_metter{
			/* cust_battery_meter.h */
			/* ADC resistor  */
			r_bat_sense = <4 >;
			r_i_sense = <4 >;
			r_charger_1 = <330 >;
			r_charger_2 = <39 >;
			temperature_t0 = <110 >;
			temperature_t1 = <0 >;
			temperature_t2 = <25 >;
			temperature_t3 = <50 >;
			temperature_t = <255 >;	/* this should be fixed, never change the value */
			fg_meter_resistance = <0 >;

			/* Qmax for 0mA */
			q_max_pos_50 = <3215 >;
			q_max_pos_25 = <3207 >;
			q_max_pos_0 =  <3225 >;
			q_max_neg_10 = <3093 >;
			/* Qmax for 400mA, said high current */
			q_max_pos_50_h_current = <3154 >;
			q_max_pos_25_h_current = <3155 >;
			q_max_pos_0_h_current =  <2944 >;
			q_max_neg_10_h_current = <1525 >;
			/* Discharge percentage, 1: D5, 0: D2 */
			oam_d5 = <0 >;

			change_tracking_point = <1 >;
			/* SW OCV tracking setting */
			cust_tracking_point = <1 >;
			cust_r_sense = <20 >;
			cust_hw_cc = <0 >;
			aging_tuning_value = <103 >;
			cust_r_fg_offset = <0 >;
			ocv_board_compesate = <0 >;
			r_fg_board_base = <1000 >;
			r_fg_board_slope = <1000 >;
			car_tune_value = <110 >;   /* aka.jiang add important */

			/* HW Fuel gague  */
			current_detect_r_fg = <10 >;	/* Unit: mA */
			minerroroffset = <1000 >;
			fg_vbat_average_size = <18 >;
			r_fg_value = <10 >;	/* Unit: mOhm */  /* aka.jiang add important */

			cust_poweron_delta_capacity_tolrance = <30 >;
			cust_poweron_low_capacity_tolrance = <5 >;
			cust_poweron_max_vbat_tolrance = <90 >;
			cust_poweron_delta_vbat_tolrance = <30 >;
			cust_poweron_delta_hw_sw_ocv_capacity_tolrance = <10 >;

			/* fg 2.0 */
			difference_hwocv_rtc = <30 >;
			difference_hwocv_swocv = <10 >;
			difference_swocv_rtc = <10 >;
			difference_hwocv_vbat = <10 >;
			difference_vbat_rtc = <30 >;
			difference_swocv_rtc_pos = <15 >;
			max_swocv = <3 >;

			batterypseudo100 = <95 >;   /* aka.jiang add important */
			batterypseudo1 = <7 >;     /* aka.jiang add important */

			q_max_sys_voltage = <3050 >;
			shutdown_gauge0 = <1 >;
			shutdown_gauge1_xmins = <1 >;
			shutdown_gauge1_mins = <60 >;

			shutdown_system_voltage = <3100 >;
			charge_tracking_time = <60 >;
			discharge_tracking_time = <10 >;

			recharge_tolerance = <10 >;


			/* SW Fuel Gauge */
			max_hwocv = <5 >;
			max_vbat = <90 >;

			/* Fixed battery temperature */
			fixed_tbat_25 = <0 >;
			/* Dynamic change wake up period of battery thread when suspend */
			vbat_normal_wakeup = <3600 >;	/* Unit: mV */
			vbat_low_power_wakeup = <3500 >;	/* Unit: mV */
			normal_wakeup_period = <5400 >;	/* Unit: second */
			low_power_wakeup_period = <300 >;	/* Unit: second */
			close_poweroff_wakeup_period = <30 >;	/* Unit: second */

			init_soc_by_sw_soc = <1 >;
			mtk_enable_aging_algorithm = <1 >;
			md_sleep_current_check = <1 >;
			q_max_by_current = <0 >;

			rbat_pull_up_r = <24000 >;
			rbat_pull_up_volt = <2800 >;


			batt_temperature_table_num = <17 >;
			batt_temperature_table = <
			    (-20) 68237
			    (-15) 53650
			    (-10) 42506
			    (-5) 33892
			    0 27219
			    5 22021
			    10 17926
			    15 14674
			    20 12081
			    25 10000 30 8315 35 6948 40 5834 45 4917 50 4161 55 3535 60 3014 >;
			battery_profile_t0_num = <64 >;
			battery_profile_t0 = < 0	4401
						2	4369
						3	4343
						5	4318
						7	4294
						8	4272
						10	4250
						12	4229
						14	4209
						15	4190
						17	4171
						19	4153
						20	4134
						22	4116
						24	4100
						25	4084
						27	4067
						29	4046
						30	4022
						32	3999
						34	3980
						36	3964
						37	3951
						39	3938
						41	3925
						42	3912
						44	3899
						46	3887
						47	3875
						49	3864
						51	3854
						52	3845
						54	3836
						56	3828
						58	3820
						59	3813
						61	3807
						63	3802
						64	3797
						66	3793
						68	3789
						69	3786
						71	3782
						73	3778
						74	3774
						76	3769
						78	3764
						80	3758
						81	3751
						83	3744
						85	3736
						86	3728
						88	3720
						90	3713
						91	3707
						93	3702
						95	3695
						96	3687
						97	3681
						98	3674
						99	3668
						99	3660
						100	3652
						100	3400 >;
			battery_profile_t1_num = <64 >;
			battery_profile_t1 = < 0	4397
						2	4372
						3	4349
						5	4328
						7	4308
						8	4288
						10	4268
						11	4249
						13	4230
						15	4211
						16	4192
						18	4174
						20	4156
						21	4138
						23	4121
						24	4103
						26	4087
						28	4072
						29	4056
						31	4035
						33	4011
						34	3990
						36	3974
						37	3961
						39	3947
						41	3933
						42	3919
						44	3904
						46	3891
						47	3879
						49	3867
						51	3856
						52	3846
						54	3838
						55	3830
						57	3822
						59	3815
						60	3809
						62	3803
						64	3797
						65	3793
						67	3789
						68	3785
						70	3782
						72	3779
						73	3776
						75	3772
						77	3768
						78	3763
						80	3757
						81	3749
						83	3740
						85	3730
						86	3718
						88	3707
						90	3700
						91	3695
						93	3691
						95	3684
						96	3667
						98	3616
						99	3557
						100	3517
						100	3400 >;
			battery_profile_t2_num = <64 >;
			battery_profile_t2 = < 0	4394
						2	4369
						3	4347
						5	4324
						7	4302
						8	4281
						10	4260
						11	4239
						13	4219
						15	4199
						16	4179
						18	4160
						20	4141
						21	4123
						23	4105
						24	4087
						26	4070
						28	4054
						29	4038
						31	4022
						33	4007
						34	3993
						36	3980
						38	3966
						39	3954
						41	3940
						42	3925
						44	3909
						46	3892
						47	3877
						49	3864
						51	3854
						52	3844
						54	3836
						55	3828
						57	3821
						59	3815
						60	3809
						62	3803
						64	3798
						65	3793
						67	3789
						69	3785
						70	3780
						72	3775
						73	3770
						75	3764
						77	3758
						78	3751
						80	3744
						82	3739
						83	3730
						85	3719
						86	3708
						88	3693
						90	3689
						91	3688
						93	3686
						95	3682
						96	3651
						98	3577
						100	3459
						101	3264
						101	3228 >;
			battery_profile_t3_num = <64 >;
			battery_profile_t3 = < 0	4388
						2	4367
						3	4348
						5	4329
						7	4309
						8	4290
						10	4271
						11	4252
						13	4233
						15	4214
						16	4195
						18	4176
						20	4158
						21	4140
						23	4122
						24	4104
						26	4087
						28	4070
						29	4054
						31	4038
						33	4022
						34	4007
						36	3993
						37	3978
						39	3965
						41	3951
						42	3937
						44	3922
						46	3905
						47	3888
						49	3873
						50	3862
						52	3852
						54	3843
						55	3834
						57	3826
						59	3819
						60	3812
						62	3806
						63	3800
						65	3795
						67	3790
						68	3785
						70	3780
						72	3774
						73	3762
						75	3753
						76	3747
						78	3739
						80	3732
						81	3726
						83	3720
						85	3709
						86	3698
						88	3685
						89	3677
						91	3675
						93	3674
						94	3671
						96	3657
						98	3595
						99	3493
						101	3301
						101	3142 >;

			r_profile_t0_num = <64 >;
			r_profile_t0 = < 1368	4401
						1368	4369
						1357	4343
						1338	4318
						1314	4294
						1292	4272
						1271	4250
						1248	4229
						1229	4209
						1210	4190
						1193	4171
						1178	4153
						1161	4134
						1145	4116
						1136	4100
						1126	4084
						1118	4067
						1099	4046
						1079	4022
						1060	3999
						1046	3980
						1043	3964
						1039	3951
						1039	3938
						1031	3925
						1029	3912
						1023	3899
						1019	3887
						1020	3875
						1016	3864
						1018	3854
						1019	3845
						1020	3836
						1026	3828
						1027	3820
						1033	3813
						1037	3807
						1043	3802
						1053	3797
						1062	3793
						1075	3789
						1090	3786
						1108	3782
						1127	3778
						1151	3774
						1176	3769
						1206	3764
						1237	3758
						1271	3751
						1308	3744
						1347	3736
						1387	3728
						1431	3720
						1479	3713
						1530	3707
						1588	3702
						1652	3695
						1717	3687
						1703	3681
						1687	3674
						1670	3668
						1651	3660
						1633	3652
						1003	3400 >;

			r_profile_t1_num = <64 >;
			r_profile_t1 = < 660	4397
						660	4372
						674	4349
						665	4328
						659	4308
						650	4288
						629	4268
						630	4249
						622	4230
						612	4211
						605	4192
						599	4174
						594	4156
						590	4138
						585	4121
						580	4103
						578	4087
						580	4072
						579	4056
						570	4035
						556	4011
						549	3990
						546	3974
						545	3961
						541	3947
						533	3933
						525	3919
						518	3904
						514	3891
						497	3879
						469	3867
						499	3856
						513	3846
						516	3838
						508	3830
						518	3822
						530	3815
						536	3809
						541	3803
						540	3797
						501	3793
						536	3789
						544	3785
						516	3782
						567	3779
						580	3776
						595	3772
						614	3768
						631	3763
						649	3757
						672	3749
						695	3740
						722	3730
						752	3718
						785	3707
						828	3700
						884	3695
						956	3691
						1056	3684
						1186	3667
						1331	3616
						1394	3557
						1294	3517
						1000	3400 >;

			r_profile_t2_num = <64 >;
			r_profile_t2 = < 142	4394
						163	4369
						163	4347
						162	4324
						160	4302
						160	4281
						159	4260
						158	4239
						158	4219
						159	4199
						159	4179
						159	4160
						159	4141
						160	4123
						160	4105
						161	4087
						162	4070
						164	4054
						166	4038
						167	4022
						170	4007
						172	3993
						185	3980
						191	3966
						191	3954
						194	3940
						192	3925
						183	3909
						170	3892
						161	3877
						157	3864
						154	3854
						153	3844
						152	3836
						152	3828
						153	3821
						153	3815
						154	3809
						156	3803
						157	3798
						158	3793
						159	3789
						160	3785
						161	3780
						160	3775
						157	3770
						155	3764
						153	3758
						153	3751
						152	3744
						154	3739
						157	3730
						156	3719
						159	3708
						156	3693
						157	3689
						161	3688
						167	3686
						181	3682
						189	3651
						214	3577
						270	3459
						663	3264
						578	3228 >;

			r_profile_t3_num = <64 >;
			r_profile_t3 = < 127	4388
						127	4367
						128	4348
						128	4329
						128	4309
						129	4290
						128	4271
						129	4252
						129	4233
						130	4214
						130	4195
						130	4176
						130	4158
						131	4140
						131	4122
						132	4104
						132	4087
						133	4070
						134	4054
						135	4038
						136	4022
						137	4007
						139	3993
						141	3978
						143	3965
						146	3951
						148	3937
						147	3922
						141	3905
						134	3888
						131	3873
						130	3862
						130	3852
						130	3843
						130	3834
						130	3826
						130	3819
						131	3812
						132	3806
						133	3800
						134	3795
						136	3790
						138	3785
						140	3780
						139	3774
						131	3762
						131	3753
						131	3747
						131	3739
						131	3732
						131	3726
						133	3720
						132	3709
						132	3698
						131	3685
						129	3677
						131	3675
						135	3674
						144	3671
						147	3657
						144	3595
						153	3493
						191	3301
						360	3142 >;
		};
