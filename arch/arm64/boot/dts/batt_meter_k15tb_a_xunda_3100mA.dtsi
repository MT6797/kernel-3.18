&bat_metter{
			/* cust_battery_meter.h */
			/* ADC resistor  */
			r_bat_sense = <4 >;
			r_i_sense = <4 >;
			r_charger_1 = <330 >;
			r_charger_2 = <39 >;
			temperature_t0 = <110 >;
			temperature_t1 = <0 >;
			temperature_t2 = <25 >;
			temperature_t3 = <50 >;
			temperature_t = <255 >;	/* this should be fixed, never change the value */
			fg_meter_resistance = <0 >;

			/* Qmax for 0mA */
			q_max_pos_50 = <3215 >;
			q_max_pos_25 = <3207 >;
			q_max_pos_0 =  <3225 >;
			q_max_neg_10 = <3093 >;
			/* Qmax for 400mA, said high current */
			q_max_pos_50_h_current = <3154 >;
			q_max_pos_25_h_current = <3155 >;
			q_max_pos_0_h_current =  <2944 >;
			q_max_neg_10_h_current = <1525 >;
			/* Discharge percentage, 1: D5, 0: D2 */
			oam_d5 = <0 >;

			change_tracking_point = <1 >;
			/* SW OCV tracking setting */
			cust_tracking_point = <1 >;
			cust_r_sense = <20 >;
			cust_hw_cc = <0 >;
			aging_tuning_value = <103 >;
			cust_r_fg_offset = <0 >;
			ocv_board_compesate = <0 >;
			r_fg_board_base = <1000 >;
			r_fg_board_slope = <1000 >;
			car_tune_value = <86 >;

			/* HW Fuel gague  */
			current_detect_r_fg = <10 >;	/* Unit: mA */
			minerroroffset = <1000 >;
			fg_vbat_average_size = <18 >;
			r_fg_value = <10 >;	/* Unit: mOhm */

			cust_poweron_delta_capacity_tolrance = <30 >;
			cust_poweron_low_capacity_tolrance = <5 >;
			cust_poweron_max_vbat_tolrance = <90 >;
			cust_poweron_delta_vbat_tolrance = <30 >;
			cust_poweron_delta_hw_sw_ocv_capacity_tolrance = <10 >;

			/* Fixed battery temperature */
			fixed_tbat_25 = <0 >;
			/* Dynamic change wake up period of battery thread when suspend */
			vbat_normal_wakeup = <3600 >;	/* Unit: mV */
			vbat_low_power_wakeup = <3500 >;	/* Unit: mV */
			normal_wakeup_period = <5400 >;	/* Unit: second */
			low_power_wakeup_period = <300 >;	/* Unit: second */
			close_poweroff_wakeup_period = <30 >;	/* Unit: second */

			rbat_pull_up_r = <16900 >;
			rbat_pull_up_volt = <1800 >;


			batt_temperature_table_num = <17 >;
			batt_temperature_table = <
			    (-20) 68237
			    (-15) 53650
			    (-10) 42506
			    (-5) 33892
			    0 27219
			    5 22021
			    10 17926
			    15 14674
			    20 12081
			    25 10000 30 8315 35 6948 40 5834 45 4917 50 4161 55 3535 60 3014 >;
			battery_profile_t0_num = <68 >;
			battery_profile_t0 = < 0    4349
								   2    4317
								   3    4292
								   5    4271
								   6    4251
								   8    4232
								   10   4214
								   11   4197
								   13   4180
								   15   4163
								   16   4147
								   18   4130
								   19   4114
								   21   4101
								   23   4089
								   24   4074
								   26   4051
								   27   4020
								   29   3993
								   31   3973
								   32   3958
								   34   3946
								   36   3936
								   37   3927
								   39   3917
								   40   3907
								   42   3896
								   44   3886
								   45   3876
								   47   3866
								   48   3856
								   50   3847
								   52   3839
								   53   3831
								   55   3824
								   57   3817
								   58   3811
								   60   3805
								   61   3800
								   63   3796
								   65   3792
								   66   3789
								   68   3786
								   69   3782
								   71   3779
								   73   3775
								   74   3772
								   76   3768
								   78   3763
								   79   3758
								   81   3753
								   82   3747
								   84   3741
								   86   3735
								   87   3728
								   89   3722
								   91   3716
								   92   3709
								   94   3701
								   95   3690
								   96   3683
								   97   3676
								   98   3670
								   98   3664
								   99   3657
								   99   3650
								   100  3643
								   100  3400	 >;
			battery_profile_t1_num = <68 >;
			battery_profile_t1 = <  0    4347  
									2    4319
									3    4297
									5    4277
									6    4258
									8    4240
									9    4223
									11   4206
									12   4190
									14   4173
									16   4157
									17   4141
									19   4124
									20   4108
									22   4095
									23   4086
									25   4076
									26   4054
									28   4020
									29   3994
									31   3977
									33   3964
									34   3954
									36   3946
									37   3938
									39   3928
									40   3915
									42   3903
									43   3890
									45   3878
									47   3866
									48   3856
									50   3847
									51   3838
									53   3831
									54   3824
									56   3818
									57   3812
									59   3807
									60   3802
									62   3797
									64   3793
									65   3789
									67   3787
									68   3784
									70   3782
									71   3780
									73   3778
									74   3775
									76   3771
									78   3767
									79   3761
									81   3755
									82   3747
									84   3738
									85   3727
									87   3717
									88   3710
									90   3705
									91   3701
									93   3697
									95   3689
									96   3662
									98   3597
									99   3494
									100  3436
									100  3400
									100  3400 >;
			battery_profile_t2_num = <68 >;
			battery_profile_t2 = <  0    4345  
									2    4323
									3    4303
									5    4283
									6    4265
									8    4247
									9    4229
									11   4211
									12   4193
									14   4176
									16   4159
									17   4142
									19   4126
									20   4110
									22   4093
									23   4078
									25   4063
									27   4053
									28   4034
									30   4012
									31   3999
									33   3990
									34   3979
									36   3967
									37   3955
									39   3942
									41   3930
									42   3917
									44   3903
									45   3888
									47   3873
									48   3860
									50   3849
									51   3840
									53   3832
									55   3825
									56   3818
									58   3812
									59   3806
									61   3801
									62   3796
									64   3791
									65   3786
									67   3782
									69   3778
									70   3773
									72   3769
									73   3764
									75   3758
									76   3753
									78   3747
									80   3741
									81   3735
									83   3729
									84   3720
									86   3709
									87   3698
									89   3685
									90   3682
									92   3681
									94   3679
									95   3674
									97   3647
									98   3572
									100  3448
									100  3400
									100  3400
									100  3400 >;
			battery_profile_t3_num = <68 >;
			battery_profile_t3 = <  0   4340  
									2   4315
									3   4295
									5   4275
									6   4257
									8   4238
									9   4221
									11  4203
									12  4185
									14  4168
									16  4151
									17  4134
									19  4118
									20  4102
									22  4086
									23  4070
									25  4055
									26  4041
									28  4026
									30  4011
									31  3998
									33  3985
									34  3973
									36  3961
									37  3949
									39  3938
									40  3927
									42  3916
									44  3903
									45  3887
									47  3870
									48  3856
									50  3846
									51  3837
									53  3829
									55  3822
									56  3815
									58  3809
									59  3803
									61  3798
									62  3793
									64  3788
									65  3784
									67  3780
									69  3777
									70  3772
									72  3767
									73  3760
									75  3752
									76  3747
									78  3741
									79  3735
									81  3729
									83  3723
									84  3715
									86  3704
									87  3693
									89  3680
									90  3677
									92  3675
									93  3674
									95  3669
									97  3643
									98  3570
									100 3452
									100 3400
									100 3400
									100 3400 >;

			r_profile_t0_num = <68 >;
			r_profile_t0 = <1322 4349 
							1322 4317
							1375 4292
							1370 4271
							1358 4251
							1345 4232
							1331 4214
							1322 4197
							1311 4180
							1301 4163
							1289 4147
							1277 4130
							1265 4114
							1261 4101
							1259 4089
							1256 4074
							1237 4051
							1204 4020
							1182 3993
							1171 3973
							1165 3958
							1164 3946
							1164 3936
							1163 3927
							1160 3917
							1153 3907
							1145 3896
							1139 3886
							1069 3876
							1131 3866
							1129 3856
							1126 3847
							1124 3839
							1123 3831
							1123 3824
							1124 3817
							1124 3811
							1127 3805
							1130 3800
							1134 3796
							1140 3792
							1147 3789
							1155 3786
							1165 3782
							1176 3779
							1188 3775
							1203 3772
							1219 3768
							1236 3763
							1255 3758
							1277 3753
							1301 3747
							1329 3741
							1359 3735
							1395 3728
							1436 3722
							1485 3716
							1543 3709
							1611 3701
							1688 3690
							1707 3683
							1692 3676
							1677 3670
							1661 3664
							1644 3657
							1627 3650
							1608 3643
							1002 3400   >;

			r_profile_t1_num = <68 >;
			r_profile_t1 = <608   4347 
							608   4319
							632   4297
							628   4277
							622   4258
							613   4240
							606   4223
							601   4206
							596   4190
							592   4173
							588   4157
							585   4141
							582   4124
							578   4108
							577   4095
							585   4086
							597   4076
							590   4054
							567   4020
							556   3994
							553   3977
							551   3964
							553   3954
							556   3946
							556   3938
							550   3928
							542   3915
							538   3903
							530   3890
							524   3878
							520   3866
							517   3856
							516   3847
							515   3838
							517   3831
							517   3824
							519   3818
							521   3812
							524   3807
							526   3802
							529   3797
							532   3793
							535   3789
							539   3787
							544   3784
							550   3782
							556   3780
							563   3778
							570   3775
							578   3771
							587   3767
							597   3761
							608   3755
							620   3747
							634   3738
							650   3727
							668   3717
							689   3710
							719   3705
							757   3701
							811   3697
							885   3689
							974   3662
							1080  3597
							1236  3494
							1089  3436
							1089  3400
							1089  3400 >;

			r_profile_t2_num = <68 >;
			r_profile_t2 = <142 4345 
							356 4323
							356 4303
							356 4283
							356 4265
							356 4247
							356 4229
							357 4211
							357 4193
							357 4176
							358 4159
							359 4142
							360 4126
							361 4110
							362 4093
							363 4078
							364 4063
							374 4053
							371 4034
							367 4012
							371 3999
							377 3990
							377 3979
							378 3967
							381 3955
							382 3942
							382 3930
							381 3917
							376 3903
							368 3888
							358 3873
							353 3860
							349 3849
							348 3840
							347 3832
							347 3825
							348 3818
							348 3812
							350 3806
							352 3801
							353 3796
							354 3791
							356 3786
							356 3782
							356 3778
							356 3773
							355 3769
							353 3764
							350 3758
							350 3753
							349 3747
							349 3741
							352 3735
							355 3729
							356 3720
							356 3709
							358 3698
							353 3685
							357 3682
							365 3681
							377 3679
							397 3674
							399 3647
							397 3572
							429 3448
							429 3400
							429 3400
							429 3400 >;

			r_profile_t3_num = <68 >;
			r_profile_t3 = <400 4340  
							400 4315  
							400 4295
							401 4275
							401 4257
							402 4238
							402 4221
							403 4203
							403 4185
							403 4168
							405 4151
							405 4134
							406 4118
							407 4102
							408 4086
							409 4070
							410 4055
							412 4041
							413 4026
							414 4011
							416 3998
							417 3985
							420 3973
							422 3961
							425 3949
							428 3938
							431 3927
							434 3916
							432 3903
							422 3887
							410 3870
							404 3856
							402 3846
							401 3837
							400 3829
							400 3822
							400 3815
							401 3809
							402 3803
							403 3798
							404 3793
							406 3788
							408 3784
							410 3780
							411 3777
							411 3772
							409 3767
							403 3760
							398 3752
							400 3747
							401 3741
							401 3735
							403 3729
							407 3723
							408 3715
							407 3704
							408 3693
							402 3680
							406 3677
							414 3675
							426 3674
							448 3669
							443 3643
							430 3570
							446 3452
							446 3400
							446 3400
							446 3400 >;
		};